// SPDX-License-Identifier: GPL-2.0
/*
 * Copyright (c) 2023 Ideas on Board
 * Author: Paul Elder <paul.elder@ideasonboard.com>
 */

/dts-v1/;
/plugin/;

&{/aliases} {
       /delete-property/ ethernet0;
};

&ethernet_usb {
	local-mac-address = [1e f6 8c ca 81 96];
};
